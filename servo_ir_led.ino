#include "IRremote.hpp"
#include <ESP32Servo.h>
#include <Wire.h>
#include <Adafruit_GFX.h>
#include <Adafruit_SH110X.h>
#include <SPI.h>


#define i2c_Address 0x3c 
#define SCREEN_WIDTH 128  
#define SCREEN_HEIGHT 64  
#define OLED_RESET -1     
Adafruit_SH1106G display = Adafruit_SH1106G(SCREEN_WIDTH, SCREEN_HEIGHT, &Wire, OLED_RESET);

const uint8_t PROGMEM sc1[] = {
0xff, 0xff, 0xff, 0xff, 0xff, 0xff, 0xff, 0xff, 0xff, 0xff, 0xff, 0xff, 0xff, 0xff, 0xff, 0xff, 
0xff, 0xff, 0xff, 0xff, 0xff, 0xff, 0xff, 0xff, 0xff, 0xff, 0xff, 0xff, 0xff, 0xff, 0xff, 0xff, 
0xff, 0xff, 0xff, 0xff, 0xff, 0xff, 0xff, 0xff, 0xff, 0xff, 0xff, 0xff, 0xff, 0xff, 0xff, 0xff, 
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0xff, 0xff, 0xff, 0xff, 0xff, 0xff, 0xff, 0xff, 0xff, 0xff, 0xff, 0xff, 0xff, 0xff, 0xff, 0xff
};


const uint8_t PROGMEM sc2[] = {
0xff, 0xff, 0xff, 0xff, 0xff, 0xff, 0xff, 0xff, 0xff, 0xff, 0xff, 0xff, 0xff, 0xff, 0xff, 0xff, 
0xff, 0xff, 0xff, 0xff, 0xff, 0xff, 0xff, 0xff, 0xff, 0xff, 0xff, 0xff, 0xff, 0xff, 0xff, 0xff, 
0xff, 0xff, 0xff, 0xff, 0xff, 0xff, 0xff, 0xff, 0xff, 0xff, 0xff, 0xff, 0xff, 0xff, 0xff, 0xff, 
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0xff, 0xff, 0xff, 0xff, 0xff, 0xff, 0xff, 0xff, 0xff, 0xff, 0xff, 0xff, 0xff, 0xff, 0xff, 0xff
};



const int irReceiverPin = 27;
const int ledPin = 2;
Servo myservo;  
int pos = 0;  
int servoPin = 25;

void setup() {
  Serial.begin(9600);
  pinMode(ledPin, OUTPUT);
  IrReceiver.begin(irReceiverPin, ENABLE_LED_FEEDBACK);
  delay(250); 
  display.begin(i2c_Address, true); 
  display.display();


  ESP32PWM::allocateTimer(0);
  ESP32PWM::allocateTimer(1);
  ESP32PWM::allocateTimer(2);
  ESP32PWM::allocateTimer(3);
  myservo.setPeriodHertz(50);    
  myservo.attach(servoPin, 1000, 2000); 
}

void loop() {
  if (IrReceiver.decode()) {
    uint16_t command = IrReceiver.decodedIRData.command;
    Serial.println(command);
    if (command>100){
    delay(100);
    screen1();
    for (pos = 0; pos <= 180; pos += 1) { 
      myservo.write(pos);    
      delay(8);             
    }
    animation();
    for (pos = 180; pos >= 0; pos -= 1) { 
      myservo.write(pos);   
      delay(8);             
    }

    screen1();
    for (pos = 0; pos <= 180; pos += 1) { 
      myservo.write(pos);    
      delay(8);             
    }
    animation();
    for (pos = 180; pos >= 0; pos -= 1) { 
      myservo.write(pos);    
      delay(8);             
    }
    }

  
    IrReceiver.resume();
  }
}


void screen1() {
  display.clearDisplay();
  display.drawBitmap(0, 0, sc1, SCREEN_WIDTH, SCREEN_HEIGHT, SH110X_WHITE);
  display.display();
}

void screen2() {
  display.clearDisplay();
  display.drawBitmap(0, 0, sc2, SCREEN_WIDTH, SCREEN_HEIGHT, SH110X_WHITE);
  display.display();
}

void animation(){
  screen1();
  delay(50);             
  screen2();
  delay(50);            
  screen1();
  delay(50);     
  screen2();
}
